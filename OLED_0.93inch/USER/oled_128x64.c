#include "oled_128x64.h"
const uint8_t Font5x7[][5] = {
    // ASCII 32 (space) -> 126 (~)
    {0x00,0x00,0x00,0x00,0x00}, // 32  
    {0x00,0x00,0x5F,0x00,0x00}, // 33 !
    {0x00,0x07,0x00,0x07,0x00}, // 34 "
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    {0x08,0x04,0x08,0x10,0x08}, // 126 ~
};

I2C_Handle_t* pOLED_I2CHandle;


void OLED_SendCommand(uint8_t cmd)
{
    uint8_t buf[2];
    buf[0] = 0x00;    // control byte: command
    buf[1] = cmd;
    I2C_MasterSendData(pOLED_I2CHandle, buf, 2, 0x3C, 0);
}

void OLED_SendData(uint8_t data)
{
    uint8_t buf[2];
    buf[0] = 0x40;    // control byte: data
    buf[1] = data;
    I2C_MasterSendData(pOLED_I2CHandle, buf, 2, 0x3C, 0);
}
void OLED_Init(I2C_Handle_t* pI2CxHandle)
{
		pOLED_I2CHandle = pI2CxHandle;
    OLED_SendCommand(0xAE); // Display OFF
    OLED_SendCommand(0xD5); OLED_SendCommand(0x80);
    OLED_SendCommand(0xA8); OLED_SendCommand(0x3F);
    OLED_SendCommand(0xD3); OLED_SendCommand(0x00);
    OLED_SendCommand(0x40);
    OLED_SendCommand(0x8D); OLED_SendCommand(0x14);
    OLED_SendCommand(0x20); OLED_SendCommand(0x00);
    OLED_SendCommand(0xA1);
    OLED_SendCommand(0xC8);
    OLED_SendCommand(0xDA); OLED_SendCommand(0x12);
    OLED_SendCommand(0x81); OLED_SendCommand(0x7F);
    OLED_SendCommand(0xD9); OLED_SendCommand(0xF1);
    OLED_SendCommand(0xDB); OLED_SendCommand(0x40);
    OLED_SendCommand(0xA4);
    OLED_SendCommand(0xA6);
    OLED_SendCommand(0xAF); // Display ON
}

void OLED_Fill(uint8_t data, uint8_t offset)
{
    for(uint8_t page = 0; page < 8; page++)
    {
        OLED_SendCommand(0xB0 + page);       // page address
        OLED_SendCommand(offset & 0x0F);     // lower column
        OLED_SendCommand(0x10 | (offset >> 4)); // higher column

        for(uint8_t col = 0; col < 128; col++)
        {
            OLED_SendData(data);
        }
    }
}

void OLED_WriteChar(char c)
{
    if(c < 32 || c > 126) c = ' '; // n?u ngoài b?ng thì in kho?ng tr?ng

    for(uint8_t i = 0; i < 5; i++)
    {
        OLED_SendData(Font5x7[c - 32][i]);
    }
    OLED_SendData(0x00); // c?t tr?ng cách ch?
}

void OLED_WriteString(const char *str)
{
    while(*str)
    {
        OLED_WriteChar(*str++);
    }
}

void OLED_SetCursor(uint8_t x, uint8_t y, uint8_t offset) 
{
    // y = page (0..7), x = column (0..127)
		x += offset;
    OLED_SendCommand(0xB0 + y);             // set page address
    OLED_SendCommand(x & 0x0F);             // lower column
    OLED_SendCommand(0x10 | (x >> 4));      // higher column
}

// Hàm chuy?n s? int thành string
void OLED_IntToString(int num, char *str)
{
    int i = 0;
    int isNegative = 0;
    
    // X? lý s? âm
    if (num < 0) {
        isNegative = 1;
        num = -num;
    }
    
    // X? lý tru?ng h?p d?c bi?t num = 0
    if (num == 0) {
        str[i++] = '0';
    }
    
    // Chuy?n d?i t?ng ch? s?
    while (num != 0) {
        int rem = num % 10;
        str[i++] = rem + '0';
        num = num / 10;
    }
    
    // Thêm d?u âm n?u c?n
    if (isNegative) {
        str[i++] = '-';
    }
    
    str[i] = '\0';
    
    // Ð?o ngu?c chu?i
    int start = 0;
    int end = i - 1;
    while (start < end) {
        char temp = str[start];
        str[start] = str[end];
        str[end] = temp;
        start++;
        end--;
    }
}

// Hàm in s? int ra OLED
void OLED_WriteInt(int num)
{
    char buffer[12]; // Ð? cho int 32-bit (-2147483648 d?n 2147483647)
    OLED_IntToString(num, buffer);
    OLED_WriteString(buffer);
}

// Hàm printf don gi?n cho OLED (ch? h? tr? %d, %s, %c)
void OLED_Printf(const char *format, ...)
{
    va_list args;
    va_start(args, format);
    
    const char *p = format;
    char buffer[12];
    
    while (*p) {
        if (*p == '%' && *(p + 1)) {
            p++; // Bo qua '%'
            switch (*p) {
                case 'd': // Integer
                {
                    int num = va_arg(args, int);
                    OLED_IntToString(num, buffer);
                    OLED_WriteString(buffer);
                    break;
                }
                case 's': // String
                {
                    char *str = va_arg(args, char*);
                    OLED_WriteString(str);
                    break;
                }
                case 'c': // Character
                {
                    char c = (char)va_arg(args, int);
                    OLED_WriteChar(c);
                    break;
                }
                case '%': // Literal %
                {
                    OLED_WriteChar('%');
                    break;
                }
                default:
                    // Format không du?c h? tr?, in ra nhu text
                    OLED_WriteChar('%');
                    OLED_WriteChar(*p);
                    break;
            }
        } else {
            OLED_WriteChar(*p);
        }
        p++;
    }
    
    va_end(args);
}

// Hàm printf v?i v? trí cursor
void OLED_PrintfAt(uint8_t x, uint8_t y, uint8_t offset, const char *format, ...)
{
    OLED_SetCursor(x, y, offset);
    
    va_list args;
    va_start(args, format);
    
    const char *p = format;
    char buffer[12];
    
    while (*p) {
        if (*p == '%' && *(p + 1)) {
            p++;
            switch (*p) {
                case 'd':
                {
                    int num = va_arg(args, int);
                    OLED_IntToString(num, buffer);
                    OLED_WriteString(buffer);
                    break;
                }
                case 's':
                {
                    char *str = va_arg(args, char*);
                    OLED_WriteString(str);
                    break;
                }
                case 'c':
                {
                    char c = (char)va_arg(args, int);
                    OLED_WriteChar(c);
                    break;
                }
                case '%':
                {
                    OLED_WriteChar('%');
                    break;
                }
                default:
                    OLED_WriteChar('%');
                    OLED_WriteChar(*p);
                    break;
            }
        } else {
            OLED_WriteChar(*p);
        }
        p++;
    }
    
    va_end(args);
}
